/* XDS v2.60: Copyright (c) 1999-2011 Excelsior, LLC. All Rights Reserved. */
/* "@(#)RealMath.c Feb  3 14:30:28 2012" */
/* Generated by XDS Modula-2 to ANSI C v4.20 translator */

#define X2C_int32
#define X2C_index32
#ifndef RealMath_H_
#include "RealMath.h"
#endif
#define RealMath_C_
#ifndef Strings_H_
#include "Strings.h"
#endif
#include "xMath.h"
#ifndef EXCEPTIONS_H_
#include "EXCEPTIONS.h"
#endif

static EXCEPTIONS_ExceptionSource source;


static void raise0(X2C_CARD32 n, const X2C_CHAR s[], X2C_CARD32 s_len)
{
   X2C_CHAR m[80];
   Strings_Concat("RealMath.", 10ul, s, s_len, m, 80ul);
   EXCEPTIONS_RAISE(source, n, m, 80ul);
} /* end raise() */


extern X2C_REAL RealMath_sqrt(X2C_REAL x)
{
   if (x<0.0f) raise0(0UL, "sqrt: negative argument", 24ul);
   return X2C_sqrt(x);
} /* end sqrt() */


extern X2C_REAL RealMath_exp(X2C_REAL x)
{
   return X2C_exp(x);
} /* end exp() */


extern X2C_REAL RealMath_ln(X2C_REAL x)
{
   if (x<=0.0f) raise0(1UL, "ln: negative or zero argument", 30ul);
   return X2C_ln(x);
} /* end ln() */


extern X2C_REAL RealMath_sin(X2C_REAL x)
{
   return X2C_sin(x);
} /* end sin() */


extern X2C_REAL RealMath_cos(X2C_REAL x)
{
   return X2C_cos(x);
} /* end cos() */


extern X2C_REAL RealMath_tan(X2C_REAL x)
{
   return X2C_tan(x);
} /* end tan() */


extern X2C_REAL RealMath_arcsin(X2C_REAL x)
{
   if ((X2C_REAL)fabs(x)>1.0f) {
      raise0(2UL, "arcsin: argument is not in range -1.0 .. 1.0", 45ul);
   }
   return X2C_arcsin(x);
} /* end arcsin() */


extern X2C_REAL RealMath_arccos(X2C_REAL x)
{
   if ((X2C_REAL)fabs(x)>1.0f) {
      raise0(3UL, "arccos: argument is not in range -1.0 .. 1.0", 45ul);
   }
   return X2C_arccos(x);
} /* end arccos() */


extern X2C_REAL RealMath_arctan(X2C_REAL x)
{
   return X2C_arctan(x);
} /* end arctan() */


extern X2C_REAL RealMath_power(X2C_REAL base, X2C_REAL exponent)
{
   if (base<=0.0f) raise0(4UL, "power: negative or zero base", 29ul);
   return X2C_pow(base, exponent);
} /* end power() */


extern X2C_INT32 RealMath_round(X2C_REAL x)
{
   X2C_LONGREAL y;
   y = X2C_floorl((X2C_LONGREAL)x);
   if (y<(-2.147483648E+9) || y>2.147483647E+9) {
      raise0(5UL, "round: integer overflow", 24ul);
   }
   return (X2C_INT32)X2C_TRUNCI(y,X2C_min_longint,X2C_max_longint);
} /* end round() */


extern X2C_BOOLEAN RealMath_IsRMathException(void)
{
   return EXCEPTIONS_IsCurrentSource(source);
} /* end IsRMathException() */


extern void RealMath_BEGIN(void)
{
   static int RealMath_init = 0;
   if (RealMath_init) return;
   RealMath_init = 1;
   EXCEPTIONS_BEGIN();
   Strings_BEGIN();
   EXCEPTIONS_AllocateSource(&source);
}


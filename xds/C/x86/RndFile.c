/* XDS v2.60: Copyright (c) 1999-2011 Excelsior, LLC. All Rights Reserved. */
/* "@(#)RndFile.c Feb  3 14:30:28 2012" */
/* Generated by XDS Modula-2 to ANSI C v4.20 translator */

#define X2C_int32
#define X2C_index32
#ifndef RndFile_H_
#include "RndFile.h"
#endif
#define RndFile_C_
#ifndef IOChan_H_
#include "IOChan.h"
#endif
#ifndef ChanConsts_H_
#include "ChanConsts.h"
#endif
#ifndef IOLink_H_
#include "IOLink.h"
#endif
#ifndef xlibOS_H_
#include "xlibOS.h"
#endif
#ifndef xmRTS_H_
#include "xmRTS.h"
#endif
#ifndef xrInt64_H_
#include "xrInt64.h"
#endif
#ifndef xDevData_H_
#include "xDevData.h"
#endif
#ifndef EXCEPTIONS_H_
#include "EXCEPTIONS.h"
#endif

X2C_CARD8 RndFile_read = 0x1U;
X2C_CARD8 RndFile_write = 0x2U;
X2C_CARD8 RndFile_old = 0x4U;
X2C_CARD8 RndFile_text = 0x8U;
X2C_CARD8 RndFile_raw = 0x10U;
union FPOS;


union FPOS {
   struct X2C_int64 rec;
   RndFile_FilePos arr;
};

static EXCEPTIONS_ExceptionSource source;


static void raise0(void)
{
   EXCEPTIONS_RAISE(source, 0UL, "RndFile.Exception", 18ul);
} /* end raise() */

static IOLink_DeviceId did;


extern void RndFile_OpenOld(IOChan_ChanId * cid, X2C_CHAR name[],
                X2C_CARD32 name_len, X2C_CARD8 flags, X2C_CARD8 * res)
{
   X2C_OSFHANDLE f;
   X2C_CARD32 tags;
   xDevData_FileName fn;
   X2C_PCOPY((void **)&name,name_len);
   flags |= 0x4U;
   if ((0x8U & flags)==0) flags |= 0x10U;
   if ((0x2U & flags)==0) flags |= 0x1U;
   IOLink_MakeChan(did, cid);
   if (*cid==IOChan_InvalidChan()) {
      *res = ChanConsts_outOfChans;
      goto label;
   }
   xDevData_MakeName(&fn, name, name_len, res);
   if (*res) {
      IOLink_UnMakeChan(did, cid);
      goto label;
   }
   if ((0x2U & flags)) tags = 0x2UL;
   else tags = 0UL;
   if ((0x1U & flags)) tags = tags|0x1UL;
   if ((0x8U & flags)) tags = tags|0x8UL;
   if ((0x10U & flags)) tags = tags|0x10UL;
   *res = X2C_fOpen(&f, fn->Adr, tags);
   if (*res) {
      IOLink_UnMakeChan(did, cid);
      xDevData_UnMakeName(&fn);
      goto label;
   }
   xDevData_Open(IOLink_DeviceTablePtrValue(*cid, did, IOChan_notAvailable, "\
", 1ul), f, fn, flags, xDevData_bmFull, res);
   if (*res) {
      IOLink_UnMakeChan(did, cid);
      xDevData_UnMakeName(&fn);
      X2C_fClose(&f);
   }
   label:;
   X2C_PFREE(name);
} /* end OpenOld() */


extern void RndFile_OpenClean(IOChan_ChanId * cid, X2C_CHAR name[],
                X2C_CARD32 name_len, X2C_CARD8 flags, X2C_CARD8 * res)
{
   X2C_OSFHANDLE f;
   X2C_CARD32 tags;
   xDevData_FileName fn;
   X2C_PCOPY((void **)&name,name_len);
   flags |= 0x2U;
   if ((0x8U & flags)==0) flags |= 0x10U;
   IOLink_MakeChan(did, cid);
   if (*cid==IOChan_InvalidChan()) {
      *res = ChanConsts_outOfChans;
      goto label;
   }
   xDevData_MakeName(&fn, name, name_len, res);
   if (*res) {
      IOLink_UnMakeChan(did, cid);
      goto label;
   }
   if ((0x4U & flags)==0 && X2C_Exists((X2C_pCHAR)fn->Adr)) {
      *res = ChanConsts_fileExists;
      xDevData_UnMakeName(&fn);
      IOLink_UnMakeChan(did, cid);
      goto label;
   }
   if ((0x1U & flags)) tags = 0x3UL;
   else tags = 0x2UL;
   tags = tags|0x4UL;
   if ((0x8U & flags)) tags = tags|0x8UL;
   if ((0x10U & flags)) tags = tags|0x10UL;
   *res = X2C_fOpen(&f, fn->Adr, tags);
   if (*res) {
      xDevData_UnMakeName(&fn);
      IOLink_UnMakeChan(did, cid);
      goto label;
   }
   xDevData_Open(IOLink_DeviceTablePtrValue(*cid, did, IOChan_notAvailable, "\
", 1ul), f, fn, flags, xDevData_bmFull, res);
   if (*res) {
      xDevData_UnMakeName(&fn);
      IOLink_UnMakeChan(did, cid);
      X2C_fClose(&f);
   }
   label:;
   X2C_PFREE(name);
} /* end OpenClean() */


extern X2C_BOOLEAN RndFile_IsRndFile(IOChan_ChanId cid)
{
   IOLink_DeviceTablePtr x;
   xDevData_DevData dd;
   if (IOLink_IsDevice(cid, did)) {
      x = IOLink_DeviceTablePtrValue(cid, did, IOChan_notAvailable, "", 1ul);
      dd = (xDevData_DevData)x->cd;
      return X2C_fGetFileType(dd->cf)==0;
   }
   return 0;
} /* end IsRndFile() */


extern X2C_BOOLEAN RndFile_IsRndFileException(void)
{
   return EXCEPTIONS_IsCurrentSource(source);
} /* end IsRndFileException() */


extern X2C_LOC * RndFile_StartPos(RndFile_FilePos RndFile_StartPos_ret,
                IOChan_ChanId cid)
{
   union FPOS p;
   if (!RndFile_IsRndFile(cid)) raise0();
   X2C_CARDTO64(&p.rec, 0UL);
   memcpy(RndFile_StartPos_ret,p.arr,8u);
   return RndFile_StartPos_ret;
} /* end StartPos() */


extern X2C_LOC * RndFile_CurrentPos(RndFile_FilePos RndFile_CurrentPos_ret,
                IOChan_ChanId cid)
{
   IOLink_DeviceTablePtr x;
   union FPOS p;
   x = IOLink_DeviceTablePtrValue(cid, did, IOChan_notAvailable, "", 1ul);
   xDevData_CurrentPos(x, &p.rec);
   memcpy(RndFile_CurrentPos_ret,p.arr,8u);
   return RndFile_CurrentPos_ret;
} /* end CurrentPos() */


extern X2C_LOC * RndFile_EndPos(RndFile_FilePos RndFile_EndPos_ret,
                IOChan_ChanId cid)
{
   IOLink_DeviceTablePtr x;
   union FPOS p;
   x = IOLink_DeviceTablePtrValue(cid, did, IOChan_notAvailable, "", 1ul);
   xDevData_Length(x, &p.rec);
   memcpy(RndFile_EndPos_ret,p.arr,8u);
   return RndFile_EndPos_ret;
} /* end EndPos() */


extern X2C_LOC * RndFile_NewPos(RndFile_FilePos RndFile_NewPos_ret,
                IOChan_ChanId cid, X2C_INT32 n, X2C_CARD32 size,
                RndFile_FilePos pos)
{
   union FPOS x;
   union FPOS c;
   RndFile_FilePos tmp;
   pos = (X2C_LOC *)memcpy(tmp,pos,8u);
   if (!RndFile_IsRndFile(cid)) raise0();
   if (size==0UL || n==0L) {
      memcpy(RndFile_NewPos_ret,pos,8u);
      return RndFile_NewPos_ret;
   }
   memcpy(c.arr,pos,8u);
   X2C_MUL64(&x.rec, n, size);
   if (X2C_ADD64(&c.rec, c.rec, x.rec)) raise0();
   memcpy(RndFile_NewPos_ret,c.arr,8u);
   return RndFile_NewPos_ret;
} /* end NewPos() */


extern void RndFile_SetPos(IOChan_ChanId cid, RndFile_FilePos pos)
{
   IOLink_DeviceTablePtr x;
   union FPOS p;
   RndFile_FilePos tmp;
   pos = (X2C_LOC *)memcpy(tmp,pos,8u);
   x = IOLink_DeviceTablePtrValue(cid, did, IOChan_notAvailable, "", 1ul);
   memcpy(p.arr,pos,8u);
   xDevData_SetPos(x, p.rec);
} /* end SetPos() */


extern void RndFile_Close(IOChan_ChanId * cid)
{
   IOLink_DeviceTablePtr x;
   xDevData_DevData f;
   X2C_OSFHANDLE cf;
   x = IOLink_DeviceTablePtrValue(*cid, did, IOChan_notAvailable, "", 1ul);
   f = xDevData_GetDevData(x);
   cf = f->cf;
   xDevData_Close(x);
   X2C_fClose(&cf);
   IOLink_UnMakeChan(did, cid);
} /* end Close() */


extern void RndFile_BEGIN(void)
{
   static int RndFile_init = 0;
   if (RndFile_init) return;
   RndFile_init = 1;
   if (sizeof(RndFile_FilePos)!=8) X2C_ASSERT(0);
   EXCEPTIONS_BEGIN();
   xDevData_BEGIN();
   IOLink_BEGIN();
   IOChan_BEGIN();
   ChanConsts_BEGIN();
   xDevData_GetDID(&did);
   EXCEPTIONS_AllocateSource(&source);
}


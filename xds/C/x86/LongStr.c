/* XDS v2.60: Copyright (c) 1999-2011 Excelsior, LLC. All Rights Reserved. */
/* "@(#)LongStr.c Feb  3 14:30:28 2012" */
/* Generated by XDS Modula-2 to ANSI C v4.20 translator */

#define X2C_int32
#define X2C_index32
#ifndef LongStr_H_
#include "LongStr.h"
#endif
#define LongStr_C_
#ifndef ConvTypes_H_
#include "ConvTypes.h"
#endif
#ifndef CharClass_H_
#include "CharClass.h"
#endif
#ifndef XReal_H_
#include "XReal.h"
#endif
#include "xPOSIX.h"
#ifndef xrInt64_H_
#include "xrInt64.h"
#endif

#define LongStr_PINF "+inf."

#define LongStr_NINF "-inf."

#define LongStr_NAN "NaN"

#define LongStr_INDEF "indef."


static X2C_BOOLEAN IsRealSpecial(X2C_LONGREAL R, X2C_CHAR s[],
                X2C_CARD32 s_len)
{
   if (R!=0.0 && X2C_DIVL(R,2.0)==R) {
      if (R<0.0) X2C_COPY("-inf.",6ul,s,s_len);
      else X2C_COPY("+inf.",6ul,s,s_len);
      return 1;
   }
   return 0;
} /* end IsRealSpecial() */

#define LongStr_EOS ""

static X2C_CARD32 max_digits;


static void store(X2C_LONGREAL * r, X2C_LONGREAL v)
{
   *r = v;
} /* end store() */


static X2C_LONGREAL add(X2C_LONGREAL a, X2C_LONGREAL b)
{
   X2C_LONGREAL r;
   store(&r, a+b);
   return r;
} /* end add() */


static X2C_LONGREAL div0(X2C_LONGREAL a, X2C_LONGREAL b)
{
   X2C_LONGREAL r;
   store(&r, X2C_DIVL(a,b));
   return r;
} /* end div() */


static X2C_CARD32 digits(void)
{
   X2C_LONGREAL u;
   if (max_digits==0UL) {
      u = 0.1;
      max_digits = 1UL;
      for (;;) {
         if (max_digits==32UL || add(1.0, u)==1.0) break;
         ++max_digits;
         u = div0(u, 10.0);
      }
      max_digits -= 2UL;
   }
   return max_digits;
} /* end digits() */


extern void LongStr_RealToFloat(X2C_LONGREAL real, X2C_CARD32 sigFigs,
                X2C_CHAR str[], X2C_CARD32 str_len)
{
   XReal_STR s;
   if (IsRealSpecial(real, str, str_len)) return;
   XReal_to_float(real, (X2C_INT32)sigFigs, 1L, (X2C_INT32)digits(), 'E', 0,
                1, s);
   XReal_strcpy(s, str, str_len);
} /* end RealToFloat() */


extern void LongStr_RealToEng(X2C_LONGREAL real, X2C_CARD32 sigFigs,
                X2C_CHAR str[], X2C_CARD32 str_len)
{
   XReal_STR s;
   if (IsRealSpecial(real, str, str_len)) return;
   XReal_to_float(real, (X2C_INT32)sigFigs, 3L, (X2C_INT32)digits(), 'E', 0,
                1, s);
   XReal_strcpy(s, str, str_len);
} /* end RealToEng() */


extern void LongStr_RealToFixed(X2C_LONGREAL real, X2C_INT32 place,
                X2C_CHAR str[], X2C_CARD32 str_len)
{
   XReal_STR s;
   if (IsRealSpecial(real, str, str_len)) return;
   XReal_to_fixed(real, place, (X2C_INT32)digits(), s);
   XReal_strcpy(s, str, str_len);
} /* end RealToFixed() */


extern void LongStr_RealToStr(X2C_LONGREAL real, X2C_CHAR str[],
                X2C_CARD32 str_len)
{
   XReal_STR s;
   if (IsRealSpecial(real, str, str_len)) return;
   XReal_to_any(real, (X2C_INT32)digits(), s, str_len);
   XReal_strcpy(s, str, str_len);
} /* end RealToStr() */

typedef X2C_CARD32 arrCARD[10];

typedef X2C_CARD32 LongBits[2];

struct LongLongBits;


struct LongLongBits {
   X2C_CARD32 w1;
   X2C_CARD32 w2;
   X2C_CARD16 hw3;
};

#define LongStr_maxPositiveExponent 308

#define LongStr_maxNegativeExponent (-324)

static LongBits LongStr_negativeZeroLB = {0UL,0x080000000UL};

static LongBits LongStr_positiveZeroLB = {0UL,0UL};

static LongBits LongStr_maxFloatLB = {0x0E0000000UL,1206910975UL};

static LongBits LongStr_minFloatLB = {0UL,916455424UL};

static struct LongLongBits LongStr_tenLLB = {0UL,0x0A0000000UL,16386U};

static arrCARD LongStr_tenpowC = {1UL,10UL,100UL,1000UL,10000UL,100000UL,
                1000000UL,10000000UL,100000000UL,1000000000UL};

#define LongStr_minValHi 494065645

#define LongStr_minValLo 841246544

#define LongStr_maxValHi 179769313

#define LongStr_maxValLo 486231570

static X2C_LONGREAL negativeZero;

static X2C_LONGREAL positiveZero;

static arrCARD _cnst = {1UL,10UL,100UL,1000UL,10000UL,100000UL,1000000UL,
                10000000UL,100000000UL,1000000000UL};

static X2C_BOOLEAN TooSmall(X2C_CARD32 n2, X2C_CARD32 x2, X2C_CARD32 x1,
                X2C_CARD32 n1, X2C_INT32 exp2)
{
   if (exp2<-324L) return 1;
   else if (exp2==-324L) {
      if (n1<9UL) return x1*_cnst[9UL-n1]<494065645UL;
      else if (x1!=494065645UL) return x1<494065645UL;
      else return x2*_cnst[9UL-n2]<841246544UL;
   }
   else return 0;
   return 0;
} /* end TooSmall() */


static X2C_BOOLEAN TooBig(X2C_CARD32 n2, X2C_CARD32 x2, X2C_CARD32 x1,
                X2C_CARD32 n1, X2C_INT32 exp2)
{
   if (exp2>308L) return 1;
   else if (exp2==308L) {
      if (n1<9UL) return x1*_cnst[9UL-n1]>179769313UL;
      else if (x1!=179769313UL) return x1<179769313UL;
      else return x2*_cnst[9UL-n2]>486231570UL;
   }
   else return 0;
   return 0;
} /* end TooBig() */


extern void LongStr_StrToReal(X2C_CHAR str[], X2C_CARD32 str_len,
                X2C_LONGREAL * real, X2C_CARD8 * res)
{
   X2C_CARD32 n;
   X2C_CARD32 x2;
   X2C_CARD32 x1;
   X2C_CARD32 n2;
   X2C_CARD32 n1;
   X2C_CARD32 i;
   X2C_CARD32 state;
   X2C_INT32 exp2;
   X2C_INT32 exp1;
   X2C_CHAR c;
   X2C_BOOLEAN mneg;
   X2C_BOOLEAN eneg;
   X2C_BOOLEAN expovf;
   c = ' ';
   i = 0UL;
   exp1 = -1L;
   exp2 = 0L;
   x1 = 0UL;
   x2 = 0UL;
   n1 = 0UL;
   n2 = 0UL;
   state = 0UL;
   eneg = 0;
   mneg = 0;
   expovf = 0;
   for (;;) {
      if (c && i<=str_len-1) {
         c = str[i];
         ++i;
      }
      else c = 0;
      if (CharClass_IsWhiteSpace(c)) c = ' ';
      switch ((unsigned)c) {
      case ' ':
         if (state) goto loop_exit;
         break;
      case '+':
      case '-':
         if (state==0UL) mneg = c=='-';
         else if (state==5UL) eneg = c=='-';
         else goto loop_exit;
         ++state;
         break;
      case '.':
         if (state<3UL) state = 35UL;
         else if (state==3UL) state = 4UL;
         else goto loop_exit;
         break;
      case 'E':
      case 'e':
         if (((state!=2UL && state!=3UL) && state!=4UL) && state!=35UL) {
            goto loop_exit;
         }
         state = 5UL;
         break;
      case '0':
      case '1':
      case '2':
      case '3':
      case '4':
      case '5':
      case '6':
      case '7':
      case '8':
      case '9':
         n = (X2C_CARD32)(X2C_CARD8)c-48UL;
         switch (state) {
         case 0UL:
         case 1UL:
         case 2UL:
            if (n==0UL) state = 2UL;
            else {
               state = 3UL;
               x1 = n;
               n1 = 1UL;
               exp1 = 0L;
            }
            break;
         case 35UL:
            if (n==0UL) --exp1;
            else {
               state = 4UL;
               x1 = n;
               n1 = 1UL;
            }
            break;
         case 3UL:
         case 4UL:
            if (n1<9UL) {
               ++n1;
               x1 = x1*10UL+n;
            }
            else if (n2<9UL) {
               ++n2;
               x2 = x2*10UL+n;
            }
            if (state==3UL) ++exp1;
            break;
         case 5UL:
         case 6UL:
         case 7UL:
            expovf = expovf || exp2>=(X2C_INT32)((2147483627UL-n)/10UL);
            if (!expovf) exp2 = exp2*10L+(X2C_INT32)n;
            state = 7UL;
            break;
         default:;
            goto loop_exit;
         } /* end switch */
         break;
      default:;
         goto loop_exit;
      } /* end switch */
   }
   loop_exit:;
   if ((((state==2UL || state==3UL) || state==4UL) || state==35UL)
                || state==7UL) {
      if (c) {
         *res = ConvTypes_strWrongFormat;
         return;
      }
      if (n1==0UL) {
         *res = ConvTypes_strAllRight;
         if (mneg) *real = negativeZero;
         else *real = positiveZero;
         return;
      }
      if (eneg) exp2 = -exp2;
      if (exp1>0L) {
         expovf = expovf || exp2>=(X2C_INT32)(X2C_max_longint-exp1);
      }
      else expovf = expovf || exp2<=(X2C_INT32)(X2C_min_longint-exp1);
      if (!expovf) exp2 += exp1;
      if (TooSmall(n2, x2, x1, n1, exp2)) {
         *res = ConvTypes_strOutOfRange;
         if (mneg) *real = negativeZero;
         else *real = positiveZero;
         return;
      }
      if (TooBig(n2, x2, x1, n1, exp2)) {
         *res = ConvTypes_strOutOfRange;
         if (mneg) *real = X2C_min_longreal;
         else *real = X2C_max_longreal;
         return;
      }
      *res = ConvTypes_strAllRight;
      *real = atof(str);
      return;
   }
   if (c==0 && state==0UL) {
      *res = ConvTypes_strEmpty;
      return;
   }
   *res = ConvTypes_strWrongFormat;
} /* end StrToReal() */


extern void LongStr_BEGIN(void)
{
   static int LongStr_init = 0;
   if (LongStr_init) return;
   LongStr_init = 1;
   if (sizeof(arrCARD)!=40) X2C_ASSERT(0);
   if (sizeof(LongBits)!=8) X2C_ASSERT(0);
   XReal_BEGIN();
   CharClass_BEGIN();
   ConvTypes_BEGIN();
   max_digits = 0UL;
}


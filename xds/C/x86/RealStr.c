/* XDS v2.60: Copyright (c) 1999-2011 Excelsior, LLC. All Rights Reserved. */
/* "@(#)RealStr.c Feb  3 14:30:28 2012" */
/* Generated by XDS Modula-2 to ANSI C v4.20 translator */

#define X2C_int32
#define X2C_index32
#ifndef RealStr_H_
#include "RealStr.h"
#endif
#define RealStr_C_
#ifndef ConvTypes_H_
#include "ConvTypes.h"
#endif
#ifndef CharClass_H_
#include "CharClass.h"
#endif
#ifndef XReal_H_
#include "XReal.h"
#endif

#define RealStr_PINF "+inf."

#define RealStr_NINF "-inf."

#define RealStr_NAN "NaN"

#define RealStr_INDEF "indef."


static X2C_BOOLEAN IsRealSpecial(X2C_REAL R, X2C_CHAR s[], X2C_CARD32 s_len)
{
   if (R!=0.0f && X2C_DIVR(R,2.0f)==R) {
      if (R<0.0f) X2C_COPY("-inf.",6ul,s,s_len);
      else X2C_COPY("+inf.",6ul,s,s_len);
      return 1;
   }
   return 0;
} /* end IsRealSpecial() */

#define RealStr_EOS ""

#define RealStr_MAXPOW 32

static X2C_CARD32 max_digits;


static void store(X2C_REAL * r, X2C_REAL v)
{
   *r = v;
} /* end store() */


static X2C_REAL add(X2C_REAL a, X2C_REAL b)
{
   X2C_REAL r;
   store(&r, a+b);
   return r;
} /* end add() */


static X2C_REAL div0(X2C_REAL a, X2C_REAL b)
{
   X2C_REAL r;
   store(&r, X2C_DIVR(a,b));
   return r;
} /* end div() */


static X2C_CARD32 digits(void)
{
   X2C_REAL u;
   if (max_digits==0UL) {
      u = 0.1f;
      max_digits = 1UL;
      for (;;) {
         if (max_digits==32UL || add(1.0f, u)==1.0f) break;
         ++max_digits;
         u = div0(u, 10.0f);
      }
      --max_digits;
   }
   return max_digits;
} /* end digits() */


extern void RealStr_StrToReal(X2C_CHAR str[], X2C_CARD32 str_len,
                X2C_REAL * real, X2C_CARD8 * res)
{
   X2C_CARD32 n;
   X2C_CARD32 e;
   X2C_CARD32 i;
   X2C_CARD32 s;
   X2C_LONGREAL p;
   X2C_LONGREAL t;
   X2C_LONGREAL r;
   X2C_CHAR c;
   X2C_BOOLEAN rneg;
   X2C_BOOLEAN neg;
   X2C_BOOLEAN rovf;
   X2C_BOOLEAN ovf;
   X2C_PCOPY((void **)&str,str_len);
   c = ' ';
   i = 0UL;
   e = 0UL;
   s = 0UL;
   r = 0.0;
   p = 1.0;
   neg = 0;
   rneg = 0;
   ovf = 0;
   rovf = 0;
   for (;;) {
      if (c && i<=str_len-1) {
         c = str[i];
         ++i;
      }
      else c = 0;
      if (CharClass_IsWhiteSpace(c)) c = ' ';
      switch ((unsigned)c) {
      case ' ':
         if (s) goto loop_exit;
         break;
      case '+':
      case '-':
         if (s==0UL) rneg = c=='-';
         else if (s==4UL) neg = c=='-';
         else goto loop_exit;
         ++s;
         break;
      case '.':
         if (s!=2UL) goto loop_exit;
         ++s;
         break;
      case 'E':
         if (s!=2UL && s!=3UL) goto loop_exit;
         s = 4UL;
         break;
      case '0':
      case '1':
      case '2':
      case '3':
      case '4':
      case '5':
      case '6':
      case '7':
      case '8':
      case '9':
         n = (X2C_CARD32)(X2C_CARD8)c-48UL;
         t = (X2C_LONGREAL)n;
         switch (s) {
         case 0UL:
         case 1UL:
         case 2UL:
            rovf = rovf || r>=X2C_DIVL((X2C_LONGREAL)X2C_max_real-t,10.0);
            if (!rovf) r = r*10.0+t;
            s = 2UL;
            break;
         case 3UL:
            p = X2C_DIVL(p,10.0);
            if (!rovf) r = r+t*p;
            break;
         case 4UL:
         case 5UL:
         case 6UL:
            ovf = ovf || e>=(X2C_max_longcard-n)/10UL;
            if (!ovf) e = e*10UL+n;
            s = 6UL;
            break;
         default:;
            goto loop_exit;
         } /* end switch */
         break;
      default:;
         goto loop_exit;
      } /* end switch */
   }
   loop_exit:;
   if ((s==2UL || s==3UL) || s==6UL) {
      if (!ovf) t = XReal_power10(e, &ovf);
      if (!ovf) {
         if (neg) r = X2C_DIVL(r,t);
         else {
            ovf = X2C_DIVL((X2C_LONGREAL)X2C_max_real,t)<=r;
            if (!ovf) r = r*t;
         }
      }
      if (ovf) {
         if (!rovf && neg) r = 0.0;
         else if (rneg) r = (X2C_LONGREAL)X2C_min_real;
         else r = (X2C_LONGREAL)X2C_max_real;
         *res = ConvTypes_strOutOfRange;
      }
      else {
         if (rneg) r = -r;
         *res = ConvTypes_strAllRight;
      }
      if (c==0) {
         *real = (X2C_REAL)r;
         goto label;
      }
   }
   if (c==0 && s==0UL) {
      *res = ConvTypes_strEmpty;
      goto label;
   }
   *res = ConvTypes_strWrongFormat;
   label:;
   X2C_PFREE(str);
} /* end StrToReal() */


extern void RealStr_RealToFloat(X2C_REAL real, X2C_CARD32 sigFigs,
                X2C_CHAR str[], X2C_CARD32 str_len)
{
   XReal_STR s;
   if (IsRealSpecial(real, str, str_len)) return;
   XReal_to_float((X2C_LONGREAL)real, (X2C_INT32)sigFigs, 1L,
                (X2C_INT32)digits(), 'E', 0, 1, s);
   XReal_strcpy(s, str, str_len);
} /* end RealToFloat() */


extern void RealStr_RealToEng(X2C_REAL real, X2C_CARD32 sigFigs,
                X2C_CHAR str[], X2C_CARD32 str_len)
{
   XReal_STR s;
   if (IsRealSpecial(real, str, str_len)) return;
   XReal_to_float((X2C_LONGREAL)real, (X2C_INT32)sigFigs, 3L,
                (X2C_INT32)digits(), 'E', 0, 1, s);
   XReal_strcpy(s, str, str_len);
} /* end RealToEng() */


extern void RealStr_RealToFixed(X2C_REAL real, X2C_INT32 place,
                X2C_CHAR str[], X2C_CARD32 str_len)
{
   XReal_STR s;
   if (IsRealSpecial(real, str, str_len)) return;
   XReal_to_fixed((X2C_LONGREAL)real, place, (X2C_INT32)digits(), s);
   XReal_strcpy(s, str, str_len);
} /* end RealToFixed() */


extern void RealStr_RealToStr(X2C_REAL real, X2C_CHAR str[],
                X2C_CARD32 str_len)
{
   XReal_STR s;
   if (IsRealSpecial(real, str, str_len)) return;
   XReal_to_any((X2C_LONGREAL)real, (X2C_INT32)digits(), s, str_len);
   XReal_strcpy(s, str, str_len);
} /* end RealToStr() */


extern void RealStr_BEGIN(void)
{
   static int RealStr_init = 0;
   if (RealStr_init) return;
   RealStr_init = 1;
   XReal_BEGIN();
   CharClass_BEGIN();
   ConvTypes_BEGIN();
   max_digits = 0UL;
}


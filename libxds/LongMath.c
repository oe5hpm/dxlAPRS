/* XDS v2.60: Copyright (c) 1999-2011 Excelsior, LLC. All Rights Reserved. */
/* "@(#)LongMath.c Feb  3 14:31:18 2012" */
/* Generated by XDS Modula-2 to ANSI C v4.20 translator */

#define X2C_int32
#define X2C_index32
#ifndef LongMath_H_
#include "LongMath.h"
#endif
#define LongMath_C_
#ifndef Strings_H_
#include "Strings.h"
#endif
#include "xMath.h"
#ifndef EXCEPTIONS_H_
#include "EXCEPTIONS.h"
#endif

static EXCEPTIONS_ExceptionSource source;


static void raise0(X2C_CARD32 n, const X2C_CHAR s[], X2C_CARD32 s_len)
{
   X2C_CHAR m[80];
   Strings_Concat("LongMath.", 10ul, s, s_len, m, 80ul);
   EXCEPTIONS_RAISE(source, n, m, 80ul);
} /* end raise() */


extern X2C_LONGREAL LongMath_sqrt(X2C_LONGREAL x)
{
   if (x<0.0) raise0(0UL, "sqrt: negative argument", 24ul);
   return X2C_sqrtl(x);
} /* end sqrt() */


extern X2C_LONGREAL LongMath_exp(X2C_LONGREAL x)
{
   return X2C_expl(x);
} /* end exp() */


extern X2C_LONGREAL LongMath_ln(X2C_LONGREAL x)
{
   if (x<=0.0) raise0(1UL, "ln: negative or zero argument", 30ul);
   return X2C_lnl(x);
} /* end ln() */


extern X2C_LONGREAL LongMath_sin(X2C_LONGREAL x)
{
   return X2C_sinl(x);
} /* end sin() */


extern X2C_LONGREAL LongMath_cos(X2C_LONGREAL x)
{
   return X2C_cosl(x);
} /* end cos() */


extern X2C_LONGREAL LongMath_tan(X2C_LONGREAL x)
{
   return X2C_tanl(x);
} /* end tan() */


extern X2C_LONGREAL LongMath_arcsin(X2C_LONGREAL x)
{
   if (fabs(x)>1.0) {
      raise0(2UL, "arcsin: argument is not in range -1.0 .. 1.0", 45ul);
   }
   return X2C_arcsinl(x);
} /* end arcsin() */


extern X2C_LONGREAL LongMath_arccos(X2C_LONGREAL x)
{
   if (fabs(x)>1.0) {
      raise0(3UL, "arccos: argument is not in range -1.0 .. 1.0", 45ul);
   }
   return X2C_arccosl(x);
} /* end arccos() */


extern X2C_LONGREAL LongMath_arctan(X2C_LONGREAL x)
{
   return X2C_arctanl(x);
} /* end arctan() */


extern X2C_LONGREAL LongMath_power(X2C_LONGREAL base, X2C_LONGREAL exponent)
{
   if (base<=0.0) raise0(4UL, "power: negative or zero base", 29ul);
   return X2C_powl(base, exponent);
} /* end power() */


extern X2C_INT32 LongMath_round(X2C_LONGREAL x)
{
   x = X2C_floorl(x);
   if (x<(-2.147483648E+9) || x>2.147483647E+9) {
      raise0(5UL, "round: integer overflow", 24ul);
   }
   return (X2C_INT32)X2C_TRUNCI(x,X2C_min_longint,X2C_max_longint);
} /* end round() */


extern X2C_BOOLEAN LongMath_IsRMathException(void)
{
   return EXCEPTIONS_IsCurrentSource(source);
} /* end IsRMathException() */


extern void LongMath_BEGIN(void)
{
   static int LongMath_init = 0;
   if (LongMath_init) return;
   LongMath_init = 1;
   EXCEPTIONS_BEGIN();
   Strings_BEGIN();
   EXCEPTIONS_AllocateSource(&source);
}

